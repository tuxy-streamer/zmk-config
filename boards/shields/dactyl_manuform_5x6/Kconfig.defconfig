## boards/shields/dactyl_manuform_5x6/Kconfig.defconfig
```kconfig
config SPI
    default y

if SHIELD_DACTYL_MANUFORM_5x6_LEFT

    config ZMK_KEYBOARD_NAME
        default "DM-5x6(Left)"

    config ZMK_SPLIT_BLE_ROLE_CENTRAL
        default y

endif

if SHIELD_DACTYL_MANUFORM_5x6_LEFT || SHIELD_DACTYL_MANUFORM_5x6_RIGHT

    config ZMK_SPLIT
        default y

endif

if ZMK_DISPLAY

    # compilation warning: NICE_VIEW  defined without a type
    #config NICE_VIEW
    #    default y

    config NICE_VIEW_WIDGET_STATUS
        default y

endif
```

## config/west.yml
```yaml
manifest:
  remotes:
    - name: zmkfirmware
      url-base: https://github.com/zmkfirmware
   
    # Additional modules containing boards/shields/custom code can be listed here as well
    # See https://docs.zephyrproject.org/3.2.0/develop/west/manifest.html#projects
    # 
    - name: chaldon
      url-base: https://github.com/chaldon

  projects:
    - name: zmk
      remote: zmkfirmware
      revision: v0.3.0
      import: app/west.yml

    - name: zmk-driver-pmw3389
      remote: chaldon
      path: zmk-driver-pmw3389

  self:
    path: config
```
